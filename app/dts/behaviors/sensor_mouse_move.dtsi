/*
 * Copyright (c) 2020 The ZMK Contributors
 *
 * SPDX-License-Identifier: MIT
 */

/ {
	behaviors {
		/omit-if-no-ref/ xy_mmv: xy_mm: behavior_sensor_mouse_move {
			compatible = "zmk,behavior-sensor-mouse-move";
			label = "SENSOR_MOUSE_MOVE_XY";
			dimensions = <2>;
			speed = <16>;
			#sensor-binding-cells = <0>;
		};
	};
};
