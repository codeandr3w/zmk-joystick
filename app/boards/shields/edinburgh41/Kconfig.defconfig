## app/boards/shields/edinburgh41/Kconfig.defconfig
```kconfig
# Copyright (c) 2020 The ZMK Contributors
# SPDX-License-Identifier: MIT

if SHIELD_EDINBURGH41

config ZMK_KEYBOARD_NAME
    default "Edinburgh41"

config JOYSTICK
	default y

config ZMK_RGB_UNDERGLOW_AUTO_OFF_IDLE
	default y

config ZMK_RGB_UNDERGLOW_AUTO_OFF_USB
	default y

endif
```

## app/boards/shields/edinburgh41/Kconfig.shield
```kconfig
# Copyright (c) 2020 The ZMK Contributors
# SPDX-License-Identifier: MIT

config SHIELD_EDINBURGH41
    def_bool $(shields_list_contains,edinburgh41)
```

## app/dts/bindings/behaviors/zmk,behavior-sensor-mouse-move.yaml
```yaml
# Copyright (c) 2020 The ZMK Contributors
# SPDX-License-Identifier: MIT

description: Sensor push mouse a variable amount

compatible: "zmk,behavior-sensor-mouse-move"

properties:
  label:
    type: string
    required: true
  speed:
    type: int
    default: 128
  dimensions:
    type: int
    default: 2 # usually 2 for 2 dimensions, but can be 1 for x/y
  "#sensor-binding-cells":
    type: int
    const: 0
```

## app/dts/bindings/behaviors/zmk,behavior-sensor-push-key-press.yaml
```yaml
# Copyright (c) 2020 The ZMK Contributors
# SPDX-License-Identifier: MIT

description: Sensor push left/right key press behavior

compatible: "zmk,behavior-sensor-push-key-press"

properties:
  label:
    type: string
    required: true
  min_push:
    type: int
    default: 512
  "#sensor-binding-cells":
    type: int
    required: true
    const: 2

sensor-binding-cells:
  - param1
  - param2
```

## app/dts/bindings/behaviors/zmk,behavior-sensor-var-key-press.yaml
```yaml
# Copyright (c) 2020 The ZMK Contributors
# SPDX-License-Identifier: MIT

description: Sensor push left/right variable repeat key press behavior

compatible: "zmk,behavior-sensor-var-key-press"

properties:
  label:
    type: string
    required: true
  dimensions:
    type: int
    default: 2
  time:
    type: int
    default: 2048
  key_diff_x:
    type: int
    default: -1
  key_diff_y:
    type: int
    default: -1
  "#sensor-binding-cells":
    type: int
    required: true
    default: 2

sensor-binding-cells:
  - param1
  - param2
```
